## components/esp_wifi_bsp/Kconfig
```kconfig
menu "Cấu hình Wi-Fi Dự án"

    config WIFI_SSID
        string "Tên mạng Wi-Fi (SSID)"
        default "Xe Dap Dien Thanh Dat 5G"
        help
            Nhập tên mạng Wi-Fi

    config WIFI_PASSWORD
        string "Mật khẩu Wi-Fi"
        default "tuanhuyen"
        help
            Nhập mật khẩu mạng Wi-Fi.

    endmenu
```
